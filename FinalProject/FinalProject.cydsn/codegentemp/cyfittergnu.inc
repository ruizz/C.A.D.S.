.ifndef INCLUDED_CYFITTERGNU_INC
.set INCLUDED_CYFITTERGNU_INC, 1
.include "cydevicegnu.inc"
.include "cydevicegnu_trm.inc"

/* Counter_1_CounterUDB */
.set Counter_1_CounterUDB_sC16_counterdp_u0__16BIT_A0_REG, CYREG_B0_UDB10_11_A0
.set Counter_1_CounterUDB_sC16_counterdp_u0__16BIT_A1_REG, CYREG_B0_UDB10_11_A1
.set Counter_1_CounterUDB_sC16_counterdp_u0__16BIT_D0_REG, CYREG_B0_UDB10_11_D0
.set Counter_1_CounterUDB_sC16_counterdp_u0__16BIT_D1_REG, CYREG_B0_UDB10_11_D1
.set Counter_1_CounterUDB_sC16_counterdp_u0__16BIT_DP_AUX_CTL_REG, CYREG_B0_UDB10_11_ACTL
.set Counter_1_CounterUDB_sC16_counterdp_u0__16BIT_F0_REG, CYREG_B0_UDB10_11_F0
.set Counter_1_CounterUDB_sC16_counterdp_u0__16BIT_F1_REG, CYREG_B0_UDB10_11_F1
.set Counter_1_CounterUDB_sC16_counterdp_u0__A0_A1_REG, CYREG_B0_UDB10_A0_A1
.set Counter_1_CounterUDB_sC16_counterdp_u0__A0_REG, CYREG_B0_UDB10_A0
.set Counter_1_CounterUDB_sC16_counterdp_u0__A1_REG, CYREG_B0_UDB10_A1
.set Counter_1_CounterUDB_sC16_counterdp_u0__D0_D1_REG, CYREG_B0_UDB10_D0_D1
.set Counter_1_CounterUDB_sC16_counterdp_u0__D0_REG, CYREG_B0_UDB10_D0
.set Counter_1_CounterUDB_sC16_counterdp_u0__D1_REG, CYREG_B0_UDB10_D1
.set Counter_1_CounterUDB_sC16_counterdp_u0__DP_AUX_CTL_REG, CYREG_B0_UDB10_ACTL
.set Counter_1_CounterUDB_sC16_counterdp_u0__F0_F1_REG, CYREG_B0_UDB10_F0_F1
.set Counter_1_CounterUDB_sC16_counterdp_u0__F0_REG, CYREG_B0_UDB10_F0
.set Counter_1_CounterUDB_sC16_counterdp_u0__F1_REG, CYREG_B0_UDB10_F1
.set Counter_1_CounterUDB_sC16_counterdp_u0__MSK_DP_AUX_CTL_REG, CYREG_B0_UDB10_MSK_ACTL
.set Counter_1_CounterUDB_sC16_counterdp_u0__PER_DP_AUX_CTL_REG, CYREG_B0_UDB10_MSK_ACTL
.set Counter_1_CounterUDB_sC16_counterdp_u1__16BIT_A0_REG, CYREG_B0_UDB11_12_A0
.set Counter_1_CounterUDB_sC16_counterdp_u1__16BIT_A1_REG, CYREG_B0_UDB11_12_A1
.set Counter_1_CounterUDB_sC16_counterdp_u1__16BIT_D0_REG, CYREG_B0_UDB11_12_D0
.set Counter_1_CounterUDB_sC16_counterdp_u1__16BIT_D1_REG, CYREG_B0_UDB11_12_D1
.set Counter_1_CounterUDB_sC16_counterdp_u1__16BIT_DP_AUX_CTL_REG, CYREG_B0_UDB11_12_ACTL
.set Counter_1_CounterUDB_sC16_counterdp_u1__16BIT_F0_REG, CYREG_B0_UDB11_12_F0
.set Counter_1_CounterUDB_sC16_counterdp_u1__16BIT_F1_REG, CYREG_B0_UDB11_12_F1
.set Counter_1_CounterUDB_sC16_counterdp_u1__A0_A1_REG, CYREG_B0_UDB11_A0_A1
.set Counter_1_CounterUDB_sC16_counterdp_u1__A0_REG, CYREG_B0_UDB11_A0
.set Counter_1_CounterUDB_sC16_counterdp_u1__A1_REG, CYREG_B0_UDB11_A1
.set Counter_1_CounterUDB_sC16_counterdp_u1__D0_D1_REG, CYREG_B0_UDB11_D0_D1
.set Counter_1_CounterUDB_sC16_counterdp_u1__D0_REG, CYREG_B0_UDB11_D0
.set Counter_1_CounterUDB_sC16_counterdp_u1__D1_REG, CYREG_B0_UDB11_D1
.set Counter_1_CounterUDB_sC16_counterdp_u1__DP_AUX_CTL_REG, CYREG_B0_UDB11_ACTL
.set Counter_1_CounterUDB_sC16_counterdp_u1__F0_F1_REG, CYREG_B0_UDB11_F0_F1
.set Counter_1_CounterUDB_sC16_counterdp_u1__F0_REG, CYREG_B0_UDB11_F0
.set Counter_1_CounterUDB_sC16_counterdp_u1__F1_REG, CYREG_B0_UDB11_F1
.set Counter_1_CounterUDB_sC16_counterdp_u1__MSK_DP_AUX_CTL_REG, CYREG_B0_UDB11_MSK_ACTL
.set Counter_1_CounterUDB_sC16_counterdp_u1__PER_DP_AUX_CTL_REG, CYREG_B0_UDB11_MSK_ACTL
.set Counter_1_CounterUDB_sCTRLReg_AsyncCtl_ctrlreg__16BIT_CONTROL_AUX_CTL_REG, CYREG_B0_UDB10_11_ACTL
.set Counter_1_CounterUDB_sCTRLReg_AsyncCtl_ctrlreg__16BIT_CONTROL_CONTROL_REG, CYREG_B0_UDB10_11_CTL
.set Counter_1_CounterUDB_sCTRLReg_AsyncCtl_ctrlreg__16BIT_CONTROL_COUNT_REG, CYREG_B0_UDB10_11_CTL
.set Counter_1_CounterUDB_sCTRLReg_AsyncCtl_ctrlreg__16BIT_COUNT_CONTROL_REG, CYREG_B0_UDB10_11_CTL
.set Counter_1_CounterUDB_sCTRLReg_AsyncCtl_ctrlreg__16BIT_COUNT_COUNT_REG, CYREG_B0_UDB10_11_CTL
.set Counter_1_CounterUDB_sCTRLReg_AsyncCtl_ctrlreg__16BIT_MASK_MASK_REG, CYREG_B0_UDB10_11_MSK
.set Counter_1_CounterUDB_sCTRLReg_AsyncCtl_ctrlreg__16BIT_MASK_PERIOD_REG, CYREG_B0_UDB10_11_MSK
.set Counter_1_CounterUDB_sCTRLReg_AsyncCtl_ctrlreg__16BIT_PERIOD_MASK_REG, CYREG_B0_UDB10_11_MSK
.set Counter_1_CounterUDB_sCTRLReg_AsyncCtl_ctrlreg__16BIT_PERIOD_PERIOD_REG, CYREG_B0_UDB10_11_MSK
.set Counter_1_CounterUDB_sCTRLReg_AsyncCtl_ctrlreg__7__MASK, 0x80
.set Counter_1_CounterUDB_sCTRLReg_AsyncCtl_ctrlreg__7__POS, 7
.set Counter_1_CounterUDB_sCTRLReg_AsyncCtl_ctrlreg__CONTROL_AUX_CTL_REG, CYREG_B0_UDB10_ACTL
.set Counter_1_CounterUDB_sCTRLReg_AsyncCtl_ctrlreg__CONTROL_REG, CYREG_B0_UDB10_CTL
.set Counter_1_CounterUDB_sCTRLReg_AsyncCtl_ctrlreg__CONTROL_ST_REG, CYREG_B0_UDB10_ST_CTL
.set Counter_1_CounterUDB_sCTRLReg_AsyncCtl_ctrlreg__COUNT_REG, CYREG_B0_UDB10_CTL
.set Counter_1_CounterUDB_sCTRLReg_AsyncCtl_ctrlreg__COUNT_ST_REG, CYREG_B0_UDB10_ST_CTL
.set Counter_1_CounterUDB_sCTRLReg_AsyncCtl_ctrlreg__MASK, 0x80
.set Counter_1_CounterUDB_sCTRLReg_AsyncCtl_ctrlreg__MASK_CTL_AUX_CTL_REG, CYREG_B0_UDB10_MSK_ACTL
.set Counter_1_CounterUDB_sCTRLReg_AsyncCtl_ctrlreg__PERIOD_REG, CYREG_B0_UDB10_MSK
.set Counter_1_CounterUDB_sCTRLReg_AsyncCtl_ctrlreg__PER_CTL_AUX_CTL_REG, CYREG_B0_UDB10_MSK_ACTL
.set Counter_1_CounterUDB_sSTSReg_nrstSts_stsreg__0__MASK, 0x01
.set Counter_1_CounterUDB_sSTSReg_nrstSts_stsreg__0__POS, 0
.set Counter_1_CounterUDB_sSTSReg_nrstSts_stsreg__16BIT_STATUS_AUX_CTL_REG, CYREG_B0_UDB11_12_ACTL
.set Counter_1_CounterUDB_sSTSReg_nrstSts_stsreg__16BIT_STATUS_REG, CYREG_B0_UDB11_12_ST
.set Counter_1_CounterUDB_sSTSReg_nrstSts_stsreg__1__MASK, 0x02
.set Counter_1_CounterUDB_sSTSReg_nrstSts_stsreg__1__POS, 1
.set Counter_1_CounterUDB_sSTSReg_nrstSts_stsreg__2__MASK, 0x04
.set Counter_1_CounterUDB_sSTSReg_nrstSts_stsreg__2__POS, 2
.set Counter_1_CounterUDB_sSTSReg_nrstSts_stsreg__4__MASK, 0x10
.set Counter_1_CounterUDB_sSTSReg_nrstSts_stsreg__4__POS, 4
.set Counter_1_CounterUDB_sSTSReg_nrstSts_stsreg__5__MASK, 0x20
.set Counter_1_CounterUDB_sSTSReg_nrstSts_stsreg__5__POS, 5
.set Counter_1_CounterUDB_sSTSReg_nrstSts_stsreg__6__MASK, 0x40
.set Counter_1_CounterUDB_sSTSReg_nrstSts_stsreg__6__POS, 6
.set Counter_1_CounterUDB_sSTSReg_nrstSts_stsreg__MASK, 0x77
.set Counter_1_CounterUDB_sSTSReg_nrstSts_stsreg__MASK_REG, CYREG_B0_UDB11_MSK
.set Counter_1_CounterUDB_sSTSReg_nrstSts_stsreg__MASK_ST_AUX_CTL_REG, CYREG_B0_UDB11_MSK_ACTL
.set Counter_1_CounterUDB_sSTSReg_nrstSts_stsreg__PER_ST_AUX_CTL_REG, CYREG_B0_UDB11_MSK_ACTL
.set Counter_1_CounterUDB_sSTSReg_nrstSts_stsreg__STATUS_AUX_CTL_REG, CYREG_B0_UDB11_ACTL
.set Counter_1_CounterUDB_sSTSReg_nrstSts_stsreg__STATUS_CNT_REG, CYREG_B0_UDB11_ST_CTL
.set Counter_1_CounterUDB_sSTSReg_nrstSts_stsreg__STATUS_CONTROL_REG, CYREG_B0_UDB11_ST_CTL
.set Counter_1_CounterUDB_sSTSReg_nrstSts_stsreg__STATUS_REG, CYREG_B0_UDB11_ST

/* LCD_Char_1_LCDPort */
.set LCD_Char_1_LCDPort__0__MASK, 0x01
.set LCD_Char_1_LCDPort__0__PC, CYREG_PRT2_PC0
.set LCD_Char_1_LCDPort__0__PORT, 2
.set LCD_Char_1_LCDPort__0__SHIFT, 0
.set LCD_Char_1_LCDPort__1__MASK, 0x02
.set LCD_Char_1_LCDPort__1__PC, CYREG_PRT2_PC1
.set LCD_Char_1_LCDPort__1__PORT, 2
.set LCD_Char_1_LCDPort__1__SHIFT, 1
.set LCD_Char_1_LCDPort__2__MASK, 0x04
.set LCD_Char_1_LCDPort__2__PC, CYREG_PRT2_PC2
.set LCD_Char_1_LCDPort__2__PORT, 2
.set LCD_Char_1_LCDPort__2__SHIFT, 2
.set LCD_Char_1_LCDPort__3__MASK, 0x08
.set LCD_Char_1_LCDPort__3__PC, CYREG_PRT2_PC3
.set LCD_Char_1_LCDPort__3__PORT, 2
.set LCD_Char_1_LCDPort__3__SHIFT, 3
.set LCD_Char_1_LCDPort__4__MASK, 0x10
.set LCD_Char_1_LCDPort__4__PC, CYREG_PRT2_PC4
.set LCD_Char_1_LCDPort__4__PORT, 2
.set LCD_Char_1_LCDPort__4__SHIFT, 4
.set LCD_Char_1_LCDPort__5__MASK, 0x20
.set LCD_Char_1_LCDPort__5__PC, CYREG_PRT2_PC5
.set LCD_Char_1_LCDPort__5__PORT, 2
.set LCD_Char_1_LCDPort__5__SHIFT, 5
.set LCD_Char_1_LCDPort__6__MASK, 0x40
.set LCD_Char_1_LCDPort__6__PC, CYREG_PRT2_PC6
.set LCD_Char_1_LCDPort__6__PORT, 2
.set LCD_Char_1_LCDPort__6__SHIFT, 6
.set LCD_Char_1_LCDPort__AG, CYREG_PRT2_AG
.set LCD_Char_1_LCDPort__AMUX, CYREG_PRT2_AMUX
.set LCD_Char_1_LCDPort__BIE, CYREG_PRT2_BIE
.set LCD_Char_1_LCDPort__BIT_MASK, CYREG_PRT2_BIT_MASK
.set LCD_Char_1_LCDPort__BYP, CYREG_PRT2_BYP
.set LCD_Char_1_LCDPort__CTL, CYREG_PRT2_CTL
.set LCD_Char_1_LCDPort__DM0, CYREG_PRT2_DM0
.set LCD_Char_1_LCDPort__DM1, CYREG_PRT2_DM1
.set LCD_Char_1_LCDPort__DM2, CYREG_PRT2_DM2
.set LCD_Char_1_LCDPort__DR, CYREG_PRT2_DR
.set LCD_Char_1_LCDPort__INP_DIS, CYREG_PRT2_INP_DIS
.set LCD_Char_1_LCDPort__LCD_COM_SEG, CYREG_PRT2_LCD_COM_SEG
.set LCD_Char_1_LCDPort__LCD_EN, CYREG_PRT2_LCD_EN
.set LCD_Char_1_LCDPort__MASK, 0x7F
.set LCD_Char_1_LCDPort__PORT, 2
.set LCD_Char_1_LCDPort__PRT, CYREG_PRT2_PRT
.set LCD_Char_1_LCDPort__PRTDSI__CAPS_SEL, CYREG_PRT2_CAPS_SEL
.set LCD_Char_1_LCDPort__PRTDSI__DBL_SYNC_IN, CYREG_PRT2_DBL_SYNC_IN
.set LCD_Char_1_LCDPort__PRTDSI__OE_SEL0, CYREG_PRT2_OE_SEL0
.set LCD_Char_1_LCDPort__PRTDSI__OE_SEL1, CYREG_PRT2_OE_SEL1
.set LCD_Char_1_LCDPort__PRTDSI__OUT_SEL0, CYREG_PRT2_OUT_SEL0
.set LCD_Char_1_LCDPort__PRTDSI__OUT_SEL1, CYREG_PRT2_OUT_SEL1
.set LCD_Char_1_LCDPort__PRTDSI__SYNC_OUT, CYREG_PRT2_SYNC_OUT
.set LCD_Char_1_LCDPort__PS, CYREG_PRT2_PS
.set LCD_Char_1_LCDPort__SHIFT, 0
.set LCD_Char_1_LCDPort__SLW, CYREG_PRT2_SLW

/* ADC_SAR_1_ADC_SAR */
.set ADC_SAR_1_ADC_SAR__CLK, CYREG_SAR1_CLK
.set ADC_SAR_1_ADC_SAR__CSR0, CYREG_SAR1_CSR0
.set ADC_SAR_1_ADC_SAR__CSR1, CYREG_SAR1_CSR1
.set ADC_SAR_1_ADC_SAR__CSR2, CYREG_SAR1_CSR2
.set ADC_SAR_1_ADC_SAR__CSR3, CYREG_SAR1_CSR3
.set ADC_SAR_1_ADC_SAR__CSR4, CYREG_SAR1_CSR4
.set ADC_SAR_1_ADC_SAR__CSR5, CYREG_SAR1_CSR5
.set ADC_SAR_1_ADC_SAR__CSR6, CYREG_SAR1_CSR6
.set ADC_SAR_1_ADC_SAR__CSR7, CYREG_SAR1_CSR7
.set ADC_SAR_1_ADC_SAR__PM_ACT_CFG, CYREG_PM_ACT_CFG11
.set ADC_SAR_1_ADC_SAR__PM_ACT_MSK, 0x02
.set ADC_SAR_1_ADC_SAR__PM_STBY_CFG, CYREG_PM_STBY_CFG11
.set ADC_SAR_1_ADC_SAR__PM_STBY_MSK, 0x02
.set ADC_SAR_1_ADC_SAR__SW0, CYREG_SAR1_SW0
.set ADC_SAR_1_ADC_SAR__SW2, CYREG_SAR1_SW2
.set ADC_SAR_1_ADC_SAR__SW3, CYREG_SAR1_SW3
.set ADC_SAR_1_ADC_SAR__SW4, CYREG_SAR1_SW4
.set ADC_SAR_1_ADC_SAR__SW6, CYREG_SAR1_SW6
.set ADC_SAR_1_ADC_SAR__TR0, CYREG_SAR1_TR0
.set ADC_SAR_1_ADC_SAR__TRIM__TR0, CYREG_FLSHID_MFG_CFG_SAR1_TR0
.set ADC_SAR_1_ADC_SAR__TRIM__TR1, CYREG_FLSHID_MFG_CFG_SAR1_TR1
.set ADC_SAR_1_ADC_SAR__WRK0, CYREG_SAR1_WRK0
.set ADC_SAR_1_ADC_SAR__WRK1, CYREG_SAR1_WRK1

/* ADC_SAR_1_theACLK */
.set ADC_SAR_1_theACLK__CFG0, CYREG_CLKDIST_ACFG0_CFG0
.set ADC_SAR_1_theACLK__CFG1, CYREG_CLKDIST_ACFG0_CFG1
.set ADC_SAR_1_theACLK__CFG2, CYREG_CLKDIST_ACFG0_CFG2
.set ADC_SAR_1_theACLK__CFG2_SRC_SEL_MASK, 0x07
.set ADC_SAR_1_theACLK__CFG3, CYREG_CLKDIST_ACFG0_CFG3
.set ADC_SAR_1_theACLK__CFG3_PHASE_DLY_MASK, 0x0F
.set ADC_SAR_1_theACLK__INDEX, 0x00
.set ADC_SAR_1_theACLK__PM_ACT_CFG, CYREG_PM_ACT_CFG1
.set ADC_SAR_1_theACLK__PM_ACT_MSK, 0x01
.set ADC_SAR_1_theACLK__PM_STBY_CFG, CYREG_PM_STBY_CFG1
.set ADC_SAR_1_theACLK__PM_STBY_MSK, 0x01

/* ADC_SAR_1_Bypass */
.set ADC_SAR_1_Bypass__0__MASK, 0x04
.set ADC_SAR_1_Bypass__0__PC, CYREG_PRT0_PC2
.set ADC_SAR_1_Bypass__0__PORT, 0
.set ADC_SAR_1_Bypass__0__SHIFT, 2
.set ADC_SAR_1_Bypass__AG, CYREG_PRT0_AG
.set ADC_SAR_1_Bypass__AMUX, CYREG_PRT0_AMUX
.set ADC_SAR_1_Bypass__BIE, CYREG_PRT0_BIE
.set ADC_SAR_1_Bypass__BIT_MASK, CYREG_PRT0_BIT_MASK
.set ADC_SAR_1_Bypass__BYP, CYREG_PRT0_BYP
.set ADC_SAR_1_Bypass__CTL, CYREG_PRT0_CTL
.set ADC_SAR_1_Bypass__DM0, CYREG_PRT0_DM0
.set ADC_SAR_1_Bypass__DM1, CYREG_PRT0_DM1
.set ADC_SAR_1_Bypass__DM2, CYREG_PRT0_DM2
.set ADC_SAR_1_Bypass__DR, CYREG_PRT0_DR
.set ADC_SAR_1_Bypass__INP_DIS, CYREG_PRT0_INP_DIS
.set ADC_SAR_1_Bypass__LCD_COM_SEG, CYREG_PRT0_LCD_COM_SEG
.set ADC_SAR_1_Bypass__LCD_EN, CYREG_PRT0_LCD_EN
.set ADC_SAR_1_Bypass__MASK, 0x04
.set ADC_SAR_1_Bypass__PORT, 0
.set ADC_SAR_1_Bypass__PRT, CYREG_PRT0_PRT
.set ADC_SAR_1_Bypass__PRTDSI__CAPS_SEL, CYREG_PRT0_CAPS_SEL
.set ADC_SAR_1_Bypass__PRTDSI__DBL_SYNC_IN, CYREG_PRT0_DBL_SYNC_IN
.set ADC_SAR_1_Bypass__PRTDSI__OE_SEL0, CYREG_PRT0_OE_SEL0
.set ADC_SAR_1_Bypass__PRTDSI__OE_SEL1, CYREG_PRT0_OE_SEL1
.set ADC_SAR_1_Bypass__PRTDSI__OUT_SEL0, CYREG_PRT0_OUT_SEL0
.set ADC_SAR_1_Bypass__PRTDSI__OUT_SEL1, CYREG_PRT0_OUT_SEL1
.set ADC_SAR_1_Bypass__PRTDSI__SYNC_OUT, CYREG_PRT0_SYNC_OUT
.set ADC_SAR_1_Bypass__PS, CYREG_PRT0_PS
.set ADC_SAR_1_Bypass__SHIFT, 2
.set ADC_SAR_1_Bypass__SLW, CYREG_PRT0_SLW

/* VDAC8_1_viDAC8 */
.set VDAC8_1_viDAC8__CR0, CYREG_DAC2_CR0
.set VDAC8_1_viDAC8__CR1, CYREG_DAC2_CR1
.set VDAC8_1_viDAC8__D, CYREG_DAC2_D
.set VDAC8_1_viDAC8__PM_ACT_CFG, CYREG_PM_ACT_CFG8
.set VDAC8_1_viDAC8__PM_ACT_MSK, 0x04
.set VDAC8_1_viDAC8__PM_STBY_CFG, CYREG_PM_STBY_CFG8
.set VDAC8_1_viDAC8__PM_STBY_MSK, 0x04
.set VDAC8_1_viDAC8__STROBE, CYREG_DAC2_STROBE
.set VDAC8_1_viDAC8__SW0, CYREG_DAC2_SW0
.set VDAC8_1_viDAC8__SW2, CYREG_DAC2_SW2
.set VDAC8_1_viDAC8__SW3, CYREG_DAC2_SW3
.set VDAC8_1_viDAC8__SW4, CYREG_DAC2_SW4
.set VDAC8_1_viDAC8__TR, CYREG_DAC2_TR
.set VDAC8_1_viDAC8__TRIM__M1, CYREG_FLSHID_CUST_TABLES_DAC2_M1
.set VDAC8_1_viDAC8__TRIM__M2, CYREG_FLSHID_CUST_TABLES_DAC2_M2
.set VDAC8_1_viDAC8__TRIM__M3, CYREG_FLSHID_CUST_TABLES_DAC2_M3
.set VDAC8_1_viDAC8__TRIM__M4, CYREG_FLSHID_CUST_TABLES_DAC2_M4
.set VDAC8_1_viDAC8__TRIM__M5, CYREG_FLSHID_CUST_TABLES_DAC2_M5
.set VDAC8_1_viDAC8__TRIM__M6, CYREG_FLSHID_CUST_TABLES_DAC2_M6
.set VDAC8_1_viDAC8__TRIM__M7, CYREG_FLSHID_CUST_TABLES_DAC2_M7
.set VDAC8_1_viDAC8__TRIM__M8, CYREG_FLSHID_CUST_TABLES_DAC2_M8
.set VDAC8_1_viDAC8__TRIM__TR, CYREG_FLSHID_MFG_CFG_DAC2_TR
.set VDAC8_1_viDAC8__TST, CYREG_DAC2_TST

/* ADC_SAR_1_IRQ */
.set ADC_SAR_1_IRQ__INTC_CLR_EN_REG, CYREG_NVIC_CLRENA0
.set ADC_SAR_1_IRQ__INTC_CLR_PD_REG, CYREG_NVIC_CLRPEND0
.set ADC_SAR_1_IRQ__INTC_MASK, 0x01
.set ADC_SAR_1_IRQ__INTC_NUMBER, 0
.set ADC_SAR_1_IRQ__INTC_PRIOR_NUM, 7
.set ADC_SAR_1_IRQ__INTC_PRIOR_REG, CYREG_NVIC_PRI_0
.set ADC_SAR_1_IRQ__INTC_SET_EN_REG, CYREG_NVIC_SETENA0
.set ADC_SAR_1_IRQ__INTC_SET_PD_REG, CYREG_NVIC_SETPEND0

/* Control_Reg_1 */
.set Control_Reg_1_Async_ctrl_reg__0__MASK, 0x01
.set Control_Reg_1_Async_ctrl_reg__0__POS, 0
.set Control_Reg_1_Async_ctrl_reg__16BIT_CONTROL_AUX_CTL_REG, CYREG_B0_UDB11_12_ACTL
.set Control_Reg_1_Async_ctrl_reg__16BIT_CONTROL_CONTROL_REG, CYREG_B0_UDB11_12_CTL
.set Control_Reg_1_Async_ctrl_reg__16BIT_CONTROL_COUNT_REG, CYREG_B0_UDB11_12_CTL
.set Control_Reg_1_Async_ctrl_reg__16BIT_COUNT_CONTROL_REG, CYREG_B0_UDB11_12_CTL
.set Control_Reg_1_Async_ctrl_reg__16BIT_COUNT_COUNT_REG, CYREG_B0_UDB11_12_CTL
.set Control_Reg_1_Async_ctrl_reg__16BIT_MASK_MASK_REG, CYREG_B0_UDB11_12_MSK
.set Control_Reg_1_Async_ctrl_reg__16BIT_MASK_PERIOD_REG, CYREG_B0_UDB11_12_MSK
.set Control_Reg_1_Async_ctrl_reg__16BIT_PERIOD_MASK_REG, CYREG_B0_UDB11_12_MSK
.set Control_Reg_1_Async_ctrl_reg__16BIT_PERIOD_PERIOD_REG, CYREG_B0_UDB11_12_MSK
.set Control_Reg_1_Async_ctrl_reg__CONTROL_AUX_CTL_REG, CYREG_B0_UDB11_ACTL
.set Control_Reg_1_Async_ctrl_reg__CONTROL_REG, CYREG_B0_UDB11_CTL
.set Control_Reg_1_Async_ctrl_reg__CONTROL_ST_REG, CYREG_B0_UDB11_ST_CTL
.set Control_Reg_1_Async_ctrl_reg__COUNT_REG, CYREG_B0_UDB11_CTL
.set Control_Reg_1_Async_ctrl_reg__COUNT_ST_REG, CYREG_B0_UDB11_ST_CTL
.set Control_Reg_1_Async_ctrl_reg__MASK, 0x01
.set Control_Reg_1_Async_ctrl_reg__MASK_CTL_AUX_CTL_REG, CYREG_B0_UDB11_MSK_ACTL
.set Control_Reg_1_Async_ctrl_reg__PERIOD_REG, CYREG_B0_UDB11_MSK
.set Control_Reg_1_Async_ctrl_reg__PER_CTL_AUX_CTL_REG, CYREG_B0_UDB11_MSK_ACTL

/* Period_1MHz */
.set Period_1MHz__CFG0, CYREG_CLKDIST_DCFG0_CFG0
.set Period_1MHz__CFG1, CYREG_CLKDIST_DCFG0_CFG1
.set Period_1MHz__CFG2, CYREG_CLKDIST_DCFG0_CFG2
.set Period_1MHz__CFG2_SRC_SEL_MASK, 0x07
.set Period_1MHz__INDEX, 0x00
.set Period_1MHz__PM_ACT_CFG, CYREG_PM_ACT_CFG2
.set Period_1MHz__PM_ACT_MSK, 0x01
.set Period_1MHz__PM_STBY_CFG, CYREG_PM_STBY_CFG2
.set Period_1MHz__PM_STBY_MSK, 0x01

/* Pin_1 */
.set Pin_1__0__MASK, 0x02
.set Pin_1__0__PC, CYREG_PRT4_PC1
.set Pin_1__0__PORT, 4
.set Pin_1__0__SHIFT, 1
.set Pin_1__AG, CYREG_PRT4_AG
.set Pin_1__AMUX, CYREG_PRT4_AMUX
.set Pin_1__BIE, CYREG_PRT4_BIE
.set Pin_1__BIT_MASK, CYREG_PRT4_BIT_MASK
.set Pin_1__BYP, CYREG_PRT4_BYP
.set Pin_1__CTL, CYREG_PRT4_CTL
.set Pin_1__DM0, CYREG_PRT4_DM0
.set Pin_1__DM1, CYREG_PRT4_DM1
.set Pin_1__DM2, CYREG_PRT4_DM2
.set Pin_1__DR, CYREG_PRT4_DR
.set Pin_1__INP_DIS, CYREG_PRT4_INP_DIS
.set Pin_1__LCD_COM_SEG, CYREG_PRT4_LCD_COM_SEG
.set Pin_1__LCD_EN, CYREG_PRT4_LCD_EN
.set Pin_1__MASK, 0x02
.set Pin_1__PORT, 4
.set Pin_1__PRT, CYREG_PRT4_PRT
.set Pin_1__PRTDSI__CAPS_SEL, CYREG_PRT4_CAPS_SEL
.set Pin_1__PRTDSI__DBL_SYNC_IN, CYREG_PRT4_DBL_SYNC_IN
.set Pin_1__PRTDSI__OE_SEL0, CYREG_PRT4_OE_SEL0
.set Pin_1__PRTDSI__OE_SEL1, CYREG_PRT4_OE_SEL1
.set Pin_1__PRTDSI__OUT_SEL0, CYREG_PRT4_OUT_SEL0
.set Pin_1__PRTDSI__OUT_SEL1, CYREG_PRT4_OUT_SEL1
.set Pin_1__PRTDSI__SYNC_OUT, CYREG_PRT4_SYNC_OUT
.set Pin_1__PS, CYREG_PRT4_PS
.set Pin_1__SHIFT, 1
.set Pin_1__SLW, CYREG_PRT4_SLW

/* Pin_2 */
.set Pin_2__0__MASK, 0x08
.set Pin_2__0__PC, CYREG_PRT4_PC3
.set Pin_2__0__PORT, 4
.set Pin_2__0__SHIFT, 3
.set Pin_2__AG, CYREG_PRT4_AG
.set Pin_2__AMUX, CYREG_PRT4_AMUX
.set Pin_2__BIE, CYREG_PRT4_BIE
.set Pin_2__BIT_MASK, CYREG_PRT4_BIT_MASK
.set Pin_2__BYP, CYREG_PRT4_BYP
.set Pin_2__CTL, CYREG_PRT4_CTL
.set Pin_2__DM0, CYREG_PRT4_DM0
.set Pin_2__DM1, CYREG_PRT4_DM1
.set Pin_2__DM2, CYREG_PRT4_DM2
.set Pin_2__DR, CYREG_PRT4_DR
.set Pin_2__INP_DIS, CYREG_PRT4_INP_DIS
.set Pin_2__LCD_COM_SEG, CYREG_PRT4_LCD_COM_SEG
.set Pin_2__LCD_EN, CYREG_PRT4_LCD_EN
.set Pin_2__MASK, 0x08
.set Pin_2__PORT, 4
.set Pin_2__PRT, CYREG_PRT4_PRT
.set Pin_2__PRTDSI__CAPS_SEL, CYREG_PRT4_CAPS_SEL
.set Pin_2__PRTDSI__DBL_SYNC_IN, CYREG_PRT4_DBL_SYNC_IN
.set Pin_2__PRTDSI__OE_SEL0, CYREG_PRT4_OE_SEL0
.set Pin_2__PRTDSI__OE_SEL1, CYREG_PRT4_OE_SEL1
.set Pin_2__PRTDSI__OUT_SEL0, CYREG_PRT4_OUT_SEL0
.set Pin_2__PRTDSI__OUT_SEL1, CYREG_PRT4_OUT_SEL1
.set Pin_2__PRTDSI__SYNC_OUT, CYREG_PRT4_SYNC_OUT
.set Pin_2__PS, CYREG_PRT4_PS
.set Pin_2__SHIFT, 3
.set Pin_2__SLW, CYREG_PRT4_SLW

/* Pin_3 */
.set Pin_3__0__MASK, 0x20
.set Pin_3__0__PC, CYREG_PRT4_PC5
.set Pin_3__0__PORT, 4
.set Pin_3__0__SHIFT, 5
.set Pin_3__AG, CYREG_PRT4_AG
.set Pin_3__AMUX, CYREG_PRT4_AMUX
.set Pin_3__BIE, CYREG_PRT4_BIE
.set Pin_3__BIT_MASK, CYREG_PRT4_BIT_MASK
.set Pin_3__BYP, CYREG_PRT4_BYP
.set Pin_3__CTL, CYREG_PRT4_CTL
.set Pin_3__DM0, CYREG_PRT4_DM0
.set Pin_3__DM1, CYREG_PRT4_DM1
.set Pin_3__DM2, CYREG_PRT4_DM2
.set Pin_3__DR, CYREG_PRT4_DR
.set Pin_3__INP_DIS, CYREG_PRT4_INP_DIS
.set Pin_3__LCD_COM_SEG, CYREG_PRT4_LCD_COM_SEG
.set Pin_3__LCD_EN, CYREG_PRT4_LCD_EN
.set Pin_3__MASK, 0x20
.set Pin_3__PORT, 4
.set Pin_3__PRT, CYREG_PRT4_PRT
.set Pin_3__PRTDSI__CAPS_SEL, CYREG_PRT4_CAPS_SEL
.set Pin_3__PRTDSI__DBL_SYNC_IN, CYREG_PRT4_DBL_SYNC_IN
.set Pin_3__PRTDSI__OE_SEL0, CYREG_PRT4_OE_SEL0
.set Pin_3__PRTDSI__OE_SEL1, CYREG_PRT4_OE_SEL1
.set Pin_3__PRTDSI__OUT_SEL0, CYREG_PRT4_OUT_SEL0
.set Pin_3__PRTDSI__OUT_SEL1, CYREG_PRT4_OUT_SEL1
.set Pin_3__PRTDSI__SYNC_OUT, CYREG_PRT4_SYNC_OUT
.set Pin_3__PS, CYREG_PRT4_PS
.set Pin_3__SHIFT, 5
.set Pin_3__SLW, CYREG_PRT4_SLW

/* Pin_4 */
.set Pin_4__0__MASK, 0x80
.set Pin_4__0__PC, CYREG_PRT4_PC7
.set Pin_4__0__PORT, 4
.set Pin_4__0__SHIFT, 7
.set Pin_4__AG, CYREG_PRT4_AG
.set Pin_4__AMUX, CYREG_PRT4_AMUX
.set Pin_4__BIE, CYREG_PRT4_BIE
.set Pin_4__BIT_MASK, CYREG_PRT4_BIT_MASK
.set Pin_4__BYP, CYREG_PRT4_BYP
.set Pin_4__CTL, CYREG_PRT4_CTL
.set Pin_4__DM0, CYREG_PRT4_DM0
.set Pin_4__DM1, CYREG_PRT4_DM1
.set Pin_4__DM2, CYREG_PRT4_DM2
.set Pin_4__DR, CYREG_PRT4_DR
.set Pin_4__INP_DIS, CYREG_PRT4_INP_DIS
.set Pin_4__LCD_COM_SEG, CYREG_PRT4_LCD_COM_SEG
.set Pin_4__LCD_EN, CYREG_PRT4_LCD_EN
.set Pin_4__MASK, 0x80
.set Pin_4__PORT, 4
.set Pin_4__PRT, CYREG_PRT4_PRT
.set Pin_4__PRTDSI__CAPS_SEL, CYREG_PRT4_CAPS_SEL
.set Pin_4__PRTDSI__DBL_SYNC_IN, CYREG_PRT4_DBL_SYNC_IN
.set Pin_4__PRTDSI__OE_SEL0, CYREG_PRT4_OE_SEL0
.set Pin_4__PRTDSI__OE_SEL1, CYREG_PRT4_OE_SEL1
.set Pin_4__PRTDSI__OUT_SEL0, CYREG_PRT4_OUT_SEL0
.set Pin_4__PRTDSI__OUT_SEL1, CYREG_PRT4_OUT_SEL1
.set Pin_4__PRTDSI__SYNC_OUT, CYREG_PRT4_SYNC_OUT
.set Pin_4__PS, CYREG_PRT4_PS
.set Pin_4__SHIFT, 7
.set Pin_4__SLW, CYREG_PRT4_SLW

/* Pin_5 */
.set Pin_5__0__MASK, 0x01
.set Pin_5__0__PC, CYREG_PRT4_PC0
.set Pin_5__0__PORT, 4
.set Pin_5__0__SHIFT, 0
.set Pin_5__AG, CYREG_PRT4_AG
.set Pin_5__AMUX, CYREG_PRT4_AMUX
.set Pin_5__BIE, CYREG_PRT4_BIE
.set Pin_5__BIT_MASK, CYREG_PRT4_BIT_MASK
.set Pin_5__BYP, CYREG_PRT4_BYP
.set Pin_5__CTL, CYREG_PRT4_CTL
.set Pin_5__DM0, CYREG_PRT4_DM0
.set Pin_5__DM1, CYREG_PRT4_DM1
.set Pin_5__DM2, CYREG_PRT4_DM2
.set Pin_5__DR, CYREG_PRT4_DR
.set Pin_5__INP_DIS, CYREG_PRT4_INP_DIS
.set Pin_5__LCD_COM_SEG, CYREG_PRT4_LCD_COM_SEG
.set Pin_5__LCD_EN, CYREG_PRT4_LCD_EN
.set Pin_5__MASK, 0x01
.set Pin_5__PORT, 4
.set Pin_5__PRT, CYREG_PRT4_PRT
.set Pin_5__PRTDSI__CAPS_SEL, CYREG_PRT4_CAPS_SEL
.set Pin_5__PRTDSI__DBL_SYNC_IN, CYREG_PRT4_DBL_SYNC_IN
.set Pin_5__PRTDSI__OE_SEL0, CYREG_PRT4_OE_SEL0
.set Pin_5__PRTDSI__OE_SEL1, CYREG_PRT4_OE_SEL1
.set Pin_5__PRTDSI__OUT_SEL0, CYREG_PRT4_OUT_SEL0
.set Pin_5__PRTDSI__OUT_SEL1, CYREG_PRT4_OUT_SEL1
.set Pin_5__PRTDSI__SYNC_OUT, CYREG_PRT4_SYNC_OUT
.set Pin_5__PS, CYREG_PRT4_PS
.set Pin_5__SHIFT, 0
.set Pin_5__SLW, CYREG_PRT4_SLW

/* Miscellaneous */
/* -- WARNING: define names containing LEOPARD or PANTHER are deprecated and will be removed in a future release */
.set CYDEV_DEBUGGING_DPS_SWD_SWV, 6
.set CYDEV_CONFIG_UNUSED_IO_AllowButWarn, 0
.set CYDEV_CONFIGURATION_MODE_COMPRESSED, 0
.set CYDEV_CONFIG_FASTBOOT_ENABLED, 0
.set CYDEV_CHIP_REV_PANTHER_PRODUCTION, 1
.set CYDEV_CHIP_REVISION_5A_PRODUCTION, 1
.set CYDEV_CHIP_MEMBER_5A, 3
.set CYDEV_CHIP_FAMILY_PSOC5, 3
.set CYDEV_CHIP_DIE_PANTHER, 3
.set CYDEV_CHIP_DIE_EXPECT, CYDEV_CHIP_DIE_PANTHER
.set BCLK__BUS_CLK__HZ, 24000000
.set BCLK__BUS_CLK__KHZ, 24000
.set BCLK__BUS_CLK__MHZ, 24
.set CYDEV_CHIP_DIE_ACTUAL, CYDEV_CHIP_DIE_EXPECT
.set CYDEV_CHIP_DIE_LEOPARD, 1
.set CYDEV_CHIP_DIE_PSOC4A, 2
.set CYDEV_CHIP_DIE_PSOC5LP, 4
.set CYDEV_CHIP_DIE_UNKNOWN, 0
.set CYDEV_CHIP_FAMILY_PSOC3, 1
.set CYDEV_CHIP_FAMILY_PSOC4, 2
.set CYDEV_CHIP_FAMILY_UNKNOWN, 0
.set CYDEV_CHIP_FAMILY_USED, CYDEV_CHIP_FAMILY_PSOC5
.set CYDEV_CHIP_JTAG_ID, 0x0E13C069
.set CYDEV_CHIP_MEMBER_3A, 1
.set CYDEV_CHIP_MEMBER_4A, 2
.set CYDEV_CHIP_MEMBER_5B, 4
.set CYDEV_CHIP_MEMBER_UNKNOWN, 0
.set CYDEV_CHIP_MEMBER_USED, CYDEV_CHIP_MEMBER_5A
.set CYDEV_CHIP_REVISION_3A_ES1, 0
.set CYDEV_CHIP_REVISION_3A_ES2, 1
.set CYDEV_CHIP_REVISION_3A_ES3, 3
.set CYDEV_CHIP_REVISION_3A_PRODUCTION, 3
.set CYDEV_CHIP_REVISION_4A_ES0, 17
.set CYDEV_CHIP_REVISION_4A_PRODUCTION, 17
.set CYDEV_CHIP_REVISION_5A_ES0, 0
.set CYDEV_CHIP_REVISION_5A_ES1, 1
.set CYDEV_CHIP_REVISION_5B_ES0, 0
.set CYDEV_CHIP_REVISION_5B_PRODUCTION, 0
.set CYDEV_CHIP_REVISION_USED, CYDEV_CHIP_REVISION_5A_PRODUCTION
.set CYDEV_CHIP_REV_EXPECT, CYDEV_CHIP_REV_PANTHER_PRODUCTION
.set CYDEV_CHIP_REV_LEOPARD_ES1, 0
.set CYDEV_CHIP_REV_LEOPARD_ES2, 1
.set CYDEV_CHIP_REV_LEOPARD_ES3, 3
.set CYDEV_CHIP_REV_LEOPARD_PRODUCTION, 3
.set CYDEV_CHIP_REV_PANTHER_ES0, 0
.set CYDEV_CHIP_REV_PANTHER_ES1, 1
.set CYDEV_CHIP_REV_PSOC4A_ES0, 17
.set CYDEV_CHIP_REV_PSOC4A_PRODUCTION, 17
.set CYDEV_CHIP_REV_PSOC5LP_ES0, 0
.set CYDEV_CHIP_REV_PSOC5LP_PRODUCTION, 0
.set CYDEV_CONFIGURATION_COMPRESSED, 1
.set CYDEV_CONFIGURATION_DMA, 0
.set CYDEV_CONFIGURATION_ECC, 1
.set CYDEV_CONFIGURATION_IMOENABLED, CYDEV_CONFIG_FASTBOOT_ENABLED
.set CYDEV_CONFIGURATION_MODE, CYDEV_CONFIGURATION_MODE_COMPRESSED
.set CYDEV_CONFIGURATION_MODE_DMA, 2
.set CYDEV_CONFIGURATION_MODE_UNCOMPRESSED, 1
.set CYDEV_CONFIG_UNUSED_IO, CYDEV_CONFIG_UNUSED_IO_AllowButWarn
.set CYDEV_CONFIG_UNUSED_IO_AllowWithInfo, 1
.set CYDEV_CONFIG_UNUSED_IO_Disallowed, 2
.set CYDEV_DATA_CACHE_ENABLED, 0
.set CYDEV_DEBUGGING_DPS, CYDEV_DEBUGGING_DPS_SWD_SWV
.set CYDEV_DEBUGGING_DPS_Disable, 3
.set CYDEV_DEBUGGING_ENABLE, 1
.set CYDEV_DEBUGGING_REQXRES, 1
.set CYDEV_DEBUGGING_XRES, 0
.set CYDEV_DEBUG_ENABLE_MASK, 0x01
.set CYDEV_DEBUG_ENABLE_REGISTER, CYREG_MLOGIC_DBG_DBE
.set CYDEV_DMA_CHANNELS_AVAILABLE, 24
.set CYDEV_ECC_ENABLE, 0
.set CYDEV_HEAP_SIZE, 0x1000
.set CYDEV_INSTRUCT_CACHE_ENABLED, 1
.set CYDEV_INTR_RISING, 0x00000001
.set CYDEV_PROJ_TYPE, 0
.set CYDEV_PROJ_TYPE_BOOTLOADER, 1
.set CYDEV_PROJ_TYPE_LOADABLE, 2
.set CYDEV_PROJ_TYPE_MULTIAPPBOOTLOADER, 3
.set CYDEV_PROJ_TYPE_STANDARD, 0
.set CYDEV_PROTECTION_ENABLE, 0
.set CYDEV_STACK_SIZE, 0x4000
.set CYDEV_USE_BUNDLED_CMSIS, 1
.set CYDEV_VDDA_MV, 5000
.set CYDEV_VDDD_MV, 5000
.set CYDEV_VDDIO0_MV, 5000
.set CYDEV_VDDIO1_MV, 5000
.set CYDEV_VDDIO2_MV, 5000
.set CYDEV_VDDIO3_MV, 5000
.set CYDEV_VIO0, 5
.set CYDEV_VIO0_MV, 5000
.set CYDEV_VIO1, 5
.set CYDEV_VIO1_MV, 5000
.set CYDEV_VIO2, 5
.set CYDEV_VIO2_MV, 5000
.set CYDEV_VIO3, 5
.set CYDEV_VIO3_MV, 5000
.set DMA_CHANNELS_USED__MASK0, 0x00000000
.set CYDEV_BOOTLOADER_ENABLE, 0
.endif
